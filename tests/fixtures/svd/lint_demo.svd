# LintDemo register map
Vendor: DemoCorp
Registers are 32-bit, read-write, no defined reset value unless marked. A register's access mark holds for its fields unless they carry their own. Offsets are from the block's base; lines under a group give offsets from that group; [hi:lo] are bit positions; {n}, {i} and the like mark numbered series; 'fields as' and 'values as' point back to an identical list; <NAME> marks a mode.

## Memory map
0x40004000 UART size 0x400
0x40004200 TIMER size 0x100
0x40010000 FLASH size 0x20
0x40020000 DMA blocks up to offset 0x30
0x40030000 MISC
0x40040000 FIFO size 0x100
0x40050000 FPU_CPACR
0x40051000 FPU
0x40052000 TMR0
0x40053000 TIMER_ADV
0x40054000 ADCA
0x40055000 ADCB
{0x40056000+0x100*n} TMRX{n} (n=0..1)
0x40057000 DMAX
{0x40058000+0x100*n} TMRY[{n}] (n=0..1)
0x40059000 TMRZ{x} (x=0,0,1; step 0x100)
0x4005A000 TMRW{n} (n=0..1)
0x4005B000 NOTDIM
0x4005C000 GHOST%s
0x4005D000 SAME{n} (n=0..1)
0x4005E000 PWMX size 0x20
0x4005F000 FIFOX size 0x20
{0x40060000+0x100*n} OVL{n} (n=0..1) size 0x400
{0x40061000+0x100*n} SER{n} (n=0..3) size 0x100
0x40061380 SPIX
0x40062000 TMRV
0x40063000 SERX%s size 0x100
{0x40064000+0x100*n} TMRU{n} (n=0..1)
0x40070000 ALTX size 0x40

## Interrupts
40 ADCA
41 TMRX%s (TMRX{n})
42 TMRV
43 TMRU_IRQ (TMRU{n})

## UART
Base 0x40004000
0x00 DR

## TIMER
Base 0x40004200
Same registers: DMA 0x40020000, ADCA 0x40054000, ADCB 0x40055000, NOTDIM 0x4005B000, GHOST%s 0x4005C000, SPIX 0x40061380
0x00 CR

## FLASH
Base 0x40010000
0x00 CR
0x40 FAR

## FIFO
Base 0x40040000
0x00 CR
0x2000 DATA

## MISC
Base 0x40030000
0x00 REG access not given

## FPU_CPACR
Base 0x40050000
0x00 CPACR

## FPU
Base 0x40051000
0x00 FPCCR
0x04 FPCAR

## TMR0
Base 0x40052000
0x00 CR1

## TIMER_ADV
Base 0x40053000
0x00 CR1
0x04 RCR

## TMRX{n}
Base 0x40056000; array of 2, step 0x100
Same registers: TMRV 0x40062000
Registers as TIMER.

## DMAX
Base 0x40057000
0x00 CH[{x}] (x=A,B; step 0x10) group
  0x00 CTRL
0x20 EXTRA group
  0x00 CTRL

## TMRY[{n}]
Base 0x40058000; array of 2, step 0x100
Registers as TIMER.

## TMRZ{x}
Base 0x40059000; array of 3, step 0x100
Registers as TIMER.

## TMRW{n}
Base 0x4005A000; array of 2, step ?
Registers as TIMER.

## SAME{n}
Base 0x4005D000; array of 2, step 0x0
Registers as TIMER.

## PWMX
Base 0x4005E000
{0x0+8i} CH[{i}] (i=0..3)

## FIFOX
Base 0x4005F000
{0x0+4i} DATA{i} (i=0..15)

## OVL{n}
Base 0x40060000; array of 2, step 0x100
Registers as TIMER.

## SER{n}
Base 0x40061000; array of 4, step 0x100
Same registers: SERX%s 0x40063000
Registers as TIMER.

## TMRU{n}
Base 0x40064000; array of 2, step 0x100
Registers as TIMER.

## ALTX
Base 0x40070000
0x00 A_Out reset 0x0
0x00 A_In reset 0xFF (alternate view of A_Out)
0x08 B (alternate view of A_Out)
0x10 C (alternate view of C)
0x14 CCR
0x18 CCR_X
0x18 CCR_Y (alternate view of CCR_X)
0x20 D (alternate view of NOPE)
{0x28+4i} F[{i}] (i=0..1)
{0x30+4i} G[{i}] (i=0..2) (alternate view of F[{i}])
