# DemoMCU register map
Minimal demo device used by the regforge test suite
Registers are 32-bit, access not given, reset 0x0 unless marked. A register's access mark holds for its fields unless they carry their own. Offsets are from the block's base; lines under a group give offsets from that group; [hi:lo] are bit positions; {n}, {i} and the like mark numbered series; 'fields as' and 'values as' point back to an identical list; <NAME> marks a mode.

## Memory map
0x40020000 GPIOA — General purpose I/O port A

## GPIOA — General purpose I/O port A
Base 0x40020000
0x00 MODER — Mode register
  [1:0] MODE0 — Pin 0 mode
    0=INPUT; 1=OUTPUT; 2=ALTERNATE; 3=ANALOG
0x14 ODR — Output data register
  [0] OD0 — Port output data bit 0
